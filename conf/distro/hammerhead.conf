## conf/distro/hammerhead.conf
```bitbake
# Select poky as base policy
include conf/distro/poky.conf

# Add customizations
DISTRO = "hammerhead"
DISTRO_NAME = "Hammerhead Sensor Module Distro"
DISTRO_VERSION = "1.0"

LICENSE_FLAGS_ACCEPTED += " \
    synaptics-killswitch \
    commercial \
    "

# We don't want or use bluetooth
DISTRO_FEATURES:remove = "bluetooth bluez5"
```
