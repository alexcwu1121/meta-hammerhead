## conf/layer.conf
```bitbake
# meta-hammerhead/conf/layer.conf
BBPATH .= ":${LAYERDIR}"
BBFILES += "${LAYERDIR}/recipes-*/*/*.bb \
            ${LAYERDIR}/recipes-*/*/*.bbappend"

LAYERSERIES_COMPAT_meta-scarthgap = "scarthgap"

# Layer priority
BBFILE_PRIORITY_meta-hammerhead = "10"
```
